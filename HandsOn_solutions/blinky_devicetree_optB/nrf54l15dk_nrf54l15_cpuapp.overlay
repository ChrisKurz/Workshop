 / {
     board_leds {
         compatible = "gpio-leds";        
         my_led_1: my_led1 {
             gpios = <&gpio1 10 (GPIO_ACTIVE_HIGH)>;
             label = "My Green LED 1";
         };
     };
 };