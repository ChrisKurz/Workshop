## CMakeLists.txt
```
# SPDX-License-Identifier: Apache-2.0
#
# TrustZone workshop demo application
# nRF54L15 DK + nRF Connect SDK v3.4.0
#
# This is a standard Zephyr/nRF Connect SDK application. Build it with
# `west build`, as described in README.md.

cmake_minimum_required(VERSION 3.20.0)

find_package(Zephyr REQUIRED HINTS $ENV{ZEPHYR_BASE})

project(trustzone_demo)

target_sources(app PRIVATE src/main.c)
```

## prj.conf
```kconfig
# ---------------------------------------------------------------------------
# TrustZone / Trusted Firmware-M (TF-M)
# ---------------------------------------------------------------------------
# CONFIG_BUILD_WITH_TFM tells the build system to compile this application
# as the NON-SECURE image and to build + merge Trusted Firmware-M as the
# SECURE image alongside it. It only has an effect when you build for a
# "/ns" board target, e.g. nrf54l15dk/nrf54l15/cpuapp/ns.
#
# For */ns targets the nRF Connect SDK build system normally enables this
# automatically, but it is set explicitly here so the dependency is visible
# and documented.
CONFIG_BUILD_WITH_TFM=y

# TF-M profile: MINIMAL (default) keeps the Secure image small — the right
# choice for the nRF54L15's 0.5 MB flash / 96 KB RAM budget, and what this
# project uses. To try the Full profile instead (more PSA services, larger
# footprint), set this to n — see README.md, "Alternative options".
CONFIG_TFM_PROFILE_TYPE_MINIMAL=y

# ---------------------------------------------------------------------------
# PSA Crypto — used by the "call a Secure service" demo in src/main.c
# ---------------------------------------------------------------------------
# This makes psa_generate_random() available. The actual random-number
# generation executes inside TF-M / the CRACEN hardware accelerator, in the
# Secure world — the Non-secure application code never touches key material
# or the RNG peripheral directly.
CONFIG_PSA_WANT_GENERATE_RANDOM=y

# ---------------------------------------------------------------------------
# Logging / console
# ---------------------------------------------------------------------------
CONFIG_LOG=y
CONFIG_LOG_MODE_IMMEDIATE=y
CONFIG_PRINTK=y
```

## boards/nrf54l15dk_nrf54l15_cpuapp_ns.overlay
```dts
/*
 * Non-secure devicetree overlay for nrf54l15dk/nrf54l15/cpuapp/ns
 *
 * Trusted Firmware-M's Secure image uses UART1 for its own secure-side
 * boot/status log by default. If the Non-secure application also tries to
 * use UART1 (directly, or because it happens to be the board's default
 * console/shell UART), the two images conflict and the Non-secure app will
 * not run correctly.
 *
 * This overlay implements "Option A" from the workshop: disable UART1 in
 * the Non-secure image's devicetree so TF-M can own it exclusively. The
 * board's normal application console is left on its own default UART and
 * is unaffected.
 *
 * NOTE: verify the node label below (&uart1) against the nrf54l15dk
 * devicetree shipped with your installed NCS v3.4.0
 * (zephyr/boards/nordic/nrf54l15dk/nrf54l15dk_nrf54l15_cpuapp.dts and
 * associated *_common.dtsi files) — label names occasionally change
 * between SDK releases. Adjust the node reference here if it differs.
 *
 * Alternatives (see README.md, "Alternative options"):
 *   Option B — leave UART1 available here, and instead set
 *              CONFIG_TFM_LOG_LEVEL_SILENCE=y on the Secure (tfm_s) image
 *              so TF-M stops using UART1 altogether.
 *   Option C — keep this overlay, but instead of disabling UART1 outright,
 *              re-point your own console/shell backend at a different UART
 *              instance if your hardware setup needs UART1 for something
 *              else.
 */

&uart1 {
	status = "disabled";
};
```

## src/main.c
```c
/*
 * TrustZone workshop demo — Non-secure application
 *
 * Board:  nRF54L15 DK
 * SDK:    nRF Connect SDK v3.4.0
 * Target: nrf54l15dk/nrf54l15/cpuapp/ns
 *
 * This code runs entirely in the Non-secure world. It:
 *   1. Prints a boot banner so you can see, on the console UART, that the
 *      Non-secure image is alive and separate from TF-M's own Secure-side
 *      boot log (which appears on UART1 — see boards/*.overlay).
 *   2. Calls into the Secure world via the PSA Crypto API to generate
 *      random bytes. The call crosses the Non-secure Callable veneer,
 *      executes inside Trusted Firmware-M using the CRACEN hardware
 *      accelerator, and returns a result — without this file ever
 *      touching a key, the RNG peripheral, or any Secure memory directly.
 *   3. Idles, printing a heartbeat so you can confirm the app keeps running.
 */

#include <zephyr/kernel.h>
#include <zephyr/logging/log.h>

LOG_MODULE_REGISTER(trustzone_demo, LOG_LEVEL_INF);

#if defined(CONFIG_BUILD_WITH_TFM)
#include <psa/crypto.h>

/* Demonstrates calling a Secure-world service (PSA Crypto) from
 * Non-secure code. See workshop slide "Going further: call a Secure
 * crypto service".
 */
static void secure_random_demo(void)
{
	psa_status_t status;
	uint8_t random_bytes[16];

	status = psa_crypto_init();
	if (status != PSA_SUCCESS) {
		LOG_ERR("psa_crypto_init() failed: %d", (int)status);
		return;
	}

	status = psa_generate_random(random_bytes, sizeof(random_bytes));
	if (status != PSA_SUCCESS) {
		LOG_ERR("psa_generate_random() failed: %d", (int)status);
		return;
	}

	LOG_INF("Called into the SECURE world via PSA Crypto — "
		"execution happened inside TF-M / CRACEN, not here.");
	LOG_HEXDUMP_INF(random_bytes, sizeof(random_bytes),
			 "Random bytes returned by the Secure service:");
}
#endif /* CONFIG_BUILD_WITH_TFM */

int main(void)
{
	LOG_INF("*** TrustZone workshop demo ***");
	LOG_INF("Hello World! Board: %s", CONFIG_BOARD_TARGET);
	LOG_INF("This log is coming from the NON-SECURE application image.");

#if defined(CONFIG_BUILD_WITH_TFM)
	LOG_INF("CONFIG_BUILD_WITH_TFM=y — Trusted Firmware-M is running "
		"in the Secure world on this device.");
	secure_random_demo();
#else
	LOG_WRN("CONFIG_BUILD_WITH_TFM is not set — this build has no "
		"Secure/Non-secure separation. Build for the /ns board "
		"target to enable TrustZone. See README.md.");
#endif

	while (1) {
		k_sleep(K_SECONDS(5));
		LOG_INF("Non-secure application heartbeat...");
	}

	return 0;
}
```
