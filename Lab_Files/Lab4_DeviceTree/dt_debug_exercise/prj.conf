## CMakeLists.txt
```
cmake_minimum_required(VERSION 3.20.0)

find_package(Zephyr REQUIRED HINTS $ENV{ZEPHYR_BASE})
project(dt_debug_exercise)

target_sources(app PRIVATE src/main.c)
```

## prj.conf
```kconfig
CONFIG_GPIO=y
CONFIG_PRINTK=y
CONFIG_CONSOLE=y
```

## boards/nrf54l15dk_nrf54l15_cpuapp.overlay
```dts
/*
 * Debugging Exercise - nrf54l15dk/nrf54l15/cpuapp
 *
 * This overlay does not build cleanly. It contains a small number of
 * separate, realistic Devicetree mistakes. Work through them one at a
 * time using the workflow from the "Debugging DeviceTree" module of the
 * hands-on guide:
 *
 *   1. Run `west build -p always -b nrf54l15dk/nrf54l15/cpuapp dt_debug_exercise`
 *   2. Read the FIRST error/warning carefully - note the file and line.
 *   3. Fix only that one issue, then rebuild.
 *   4. Repeat until the build succeeds AND the console output at
 *      runtime looks correct (a clean build is not the same as a
 *      correct devicetree!).
 *
 * Do not peek at solution/nrf54l15dk_nrf54l15_cpuapp.overlay until
 * you have tried on your own (or are stuck for more than ~10 minutes).
 */

#include <zephyr/dt-bindings/gpio/gpio.h>

/ {
	aliases {
		my-led = &led1;
	};

	weather0: weather-station {
		compatible = "workshop,fake-sesnor";
		status = "okay";
		sensor-label = "Workshop-Weather-Node";
		sampling-frequency-hz = "fast";
		io-gpios = <&gpio2 7 GPIO_ACTIVE_HIGH>;
	};

	backup0: backup-sensor {
		compatible = "workshop,fake-sensor";
		status = "okay";
		sensor-label = "Backup-Node";
		sampling-frequency-hz = <5>;
		io-gpios = <&led9 0 GPIO_ACTIVE_HIGH>;
	};
};
```

## dts/bindings/sensor/workshop,fake-sensor.yaml
```yaml
description: |
  Workshop demo node. Represents a fictitious sensor so that participants can
  practice writing a Devicetree binding and reading custom properties with
  the DT_ macro API. It does not correspond to real hardware; the "io-gpios"
  property is wired to an LED already present on the nRF54L15 DK purely so
  the demo has something observable to blink.

compatible: "workshop,fake-sensor"

include: base.yaml

properties:
  sensor-label:
    type: string
    required: true
    description: Human readable name for this sensor instance.

  sampling-frequency-hz:
    type: int
    default: 10
    description: Sampling frequency in Hz.

  io-gpios:
    type: phandle-array
    required: true
    description: GPIO used as the sensor's "data ready" signal.
```

## src/main.c
```c
/*
 * DeviceTree Debugging Exercise - nRF54L15DK
 *
 * This code itself is correct. It will not build until the
 * accompanying board overlay (boards/nrf54l15dk_nrf54l15_cpuapp.overlay)
 * has been fixed - see that file and the hands-on guide.
 */

#include <zephyr/kernel.h>
#include <zephyr/device.h>
#include <zephyr/devicetree.h>
#include <zephyr/drivers/gpio.h>
#include <zephyr/sys/printk.h>

#define WEATHER_NODE DT_NODELABEL(weather0)
#define BACKUP_NODE  DT_NODELABEL(backup0)

static const struct gpio_dt_spec weather_io = GPIO_DT_SPEC_GET(WEATHER_NODE, io_gpios);
static const struct gpio_dt_spec backup_io  = GPIO_DT_SPEC_GET(BACKUP_NODE, io_gpios);

int main(void)
{
	printk("\n=== DeviceTree Debugging Exercise ===\n");

	printk("weather0: label=%s freq=%dHz pin=%d\n",
	       DT_PROP(WEATHER_NODE, sensor_label),
	       DT_PROP(WEATHER_NODE, sampling_frequency_hz),
	       weather_io.pin);

	printk("backup0 : label=%s freq=%dHz pin=%d\n",
	       DT_PROP(BACKUP_NODE, sensor_label),
	       DT_PROP(BACKUP_NODE, sampling_frequency_hz),
	       backup_io.pin);

	if (device_is_ready(weather_io.port) && device_is_ready(backup_io.port)) {
		printk("Both DT-described devices report ready. Overlay is fixed!\n");
	}

	while (1) {
		k_msleep(1000);
	}
	return 0;
}
```
