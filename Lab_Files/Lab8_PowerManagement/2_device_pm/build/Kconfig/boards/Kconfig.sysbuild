## Lab_Files/Lab8_PowerManagement/2_device_pm/build/Kconfig/boards/Kconfig.sysbuild
```kconfig
# Load Sysbuild board Kconfig descriptions.
osource "C:/Nordic/NCS/v3.4.0/zephyr/boards/nordic/nrf54l15dk/Kconfig.sysbuild"
```

## Lab_Files/Lab8_PowerManagement/2_device_pm/build/Kconfig/soc/Kconfig.tmp
```kconfig
# Load Zephyr SoC Kconfig descriptions.
osource "C:/Nordic/NCS/v3.4.0/zephyr/soc/xlnx/zynqmp/Kconfig"
osource "C:/Nordic/NCS/v3.4.0/zephyr/soc/xlnx/zynq7000/Kconfig"
osource "C:/Nordic/NCS/v3.4.0/zephyr/soc/xlnx/versalnet/Kconfig"
osource "C:/Nordic/NCS/v3.4.0/zephyr/soc/xlnx/versal2/Kconfig"
osource "C:/Nordic/NCS/v3.4.0/zephyr/soc/xlnx/versal/Kconfig"
osource "C:/Nordic/NCS/v3.4.0/zephyr/soc/xen/Kconfig"
osource "C:/Nordic/NCS/v3.4.0/zephyr/soc/wch/ch32v/Kconfig"
osource "C:/Nordic/NCS/v3.4.0/zephyr/soc/ti/simplelink/Kconfig"
osource "C:/Nordic/NCS/v3.4.0/zephyr/soc/ti/mspm0/Kconfig"
osource "C:/Nordic/NCS/v3.4.0/zephyr/soc/ti/lm3s6965/Kconfig"
osource "C:/Nordic/NCS/v3.4.0/zephyr/soc/ti/k3/Kconfig"
osource "C:/Nordic/NCS/v3.4.0/zephyr/soc/telink/tlsr/Kconfig"
osource "C:/Nordic/NCS/v3.4.0/zephyr/soc/syna/sr100/Kconfig"
osource "C:/Nordic/NCS/v3.4.0/zephyr/soc/starfive/jh71xx/Kconfig"
osource "C:/Nordic/NCS/v3.4.0/zephyr/soc/st/stm32/Kconfig"
osource "C:/Nordic/NCS/v3.4.0/zephyr/soc/snps/qemu_arc/Kconfig"
osource "C:/Nordic/NCS/v3.4.0/zephyr/soc/snps/nsim/arc_v/Kconfig"
osource "C:/Nordic/NCS/v3.4.0/zephyr/soc/snps/nsim/arc_classic/Kconfig"
osource "C:/Nordic/NCS/v3.4.0/zephyr/soc/snps/hsdk4xd/Kconfig"
osource "C:/Nordic/NCS/v3.4.0/zephyr/soc/snps/hsdk/Kconfig"
osource "C:/Nordic/NCS/v3.4.0/zephyr/soc/snps/emsk/Kconfig"
osource "C:/Nordic/NCS/v3.4.0/zephyr/soc/snps/emsdp/Kconfig"
osource "C:/Nordic/NCS/v3.4.0/zephyr/soc/snps/arc_iot/Kconfig"
osource "C:/Nordic/NCS/v3.4.0/zephyr/soc/silabs/Kconfig"
osource "C:/Nordic/NCS/v3.4.0/zephyr/soc/sifli/sf32/Kconfig"
osource "C:/Nordic/NCS/v3.4.0/zephyr/soc/sifive/sifive_freedom/Kconfig"
osource "C:/Nordic/NCS/v3.4.0/zephyr/soc/sensry/Kconfig"
osource "C:/Nordic/NCS/v3.4.0/zephyr/soc/rockchip/Kconfig"
osource "C:/Nordic/NCS/v3.4.0/zephyr/soc/renode/riscv_virtual/Kconfig"
osource "C:/Nordic/NCS/v3.4.0/zephyr/soc/renode/cortex_r8_virtual/Kconfig"
osource "C:/Nordic/NCS/v3.4.0/zephyr/soc/renesas/smartbond/Kconfig"
osource "C:/Nordic/NCS/v3.4.0/zephyr/soc/renesas/rz/Kconfig"
osource "C:/Nordic/NCS/v3.4.0/zephyr/soc/renesas/rx/Kconfig"
osource "C:/Nordic/NCS/v3.4.0/zephyr/soc/renesas/rcar/Kconfig"
osource "C:/Nordic/NCS/v3.4.0/zephyr/soc/renesas/ra/Kconfig"
osource "C:/Nordic/NCS/v3.4.0/zephyr/soc/realtek/fingerprint/Kconfig"
osource "C:/Nordic/NCS/v3.4.0/zephyr/soc/realtek/ec/Kconfig"
osource "C:/Nordic/NCS/v3.4.0/zephyr/soc/realtek/bee/Kconfig"
osource "C:/Nordic/NCS/v3.4.0/zephyr/soc/realtek/ameba/Kconfig"
osource "C:/Nordic/NCS/v3.4.0/zephyr/soc/raspberrypi/rpi_pico/Kconfig"
osource "C:/Nordic/NCS/v3.4.0/zephyr/soc/quicklogic/eos_s3/Kconfig"
osource "C:/Nordic/NCS/v3.4.0/zephyr/soc/qemu/virt_riscv/Kconfig"
osource "C:/Nordic/NCS/v3.4.0/zephyr/soc/qemu/or1k/Kconfig"
osource "C:/Nordic/NCS/v3.4.0/zephyr/soc/qemu/malta/Kconfig"
osource "C:/Nordic/NCS/v3.4.0/zephyr/soc/openisa/rv32m1/Kconfig"
osource "C:/Nordic/NCS/v3.4.0/zephyr/soc/openhwgroup/cva6/Kconfig"
osource "C:/Nordic/NCS/v3.4.0/zephyr/soc/oct/osd32mp15x/Kconfig"
osource "C:/Nordic/NCS/v3.4.0/zephyr/soc/nxp/s32/Kconfig"
osource "C:/Nordic/NCS/v3.4.0/zephyr/soc/nxp/rw/Kconfig"
osource "C:/Nordic/NCS/v3.4.0/zephyr/soc/nxp/mcx/Kconfig"
osource "C:/Nordic/NCS/v3.4.0/zephyr/soc/nxp/lpc/Kconfig"
osource "C:/Nordic/NCS/v3.4.0/zephyr/soc/nxp/layerscape/Kconfig"
osource "C:/Nordic/NCS/v3.4.0/zephyr/soc/nxp/kinetis/Kconfig"
osource "C:/Nordic/NCS/v3.4.0/zephyr/soc/nxp/imxrt/Kconfig"
osource "C:/Nordic/NCS/v3.4.0/zephyr/soc/nxp/imx/Kconfig"
osource "C:/Nordic/NCS/v3.4.0/zephyr/soc/nuvoton/numicro/Kconfig"
osource "C:/Nordic/NCS/v3.4.0/zephyr/soc/nuvoton/numaker/Kconfig"
osource "C:/Nordic/NCS/v3.4.0/zephyr/soc/nuvoton/npcx/Kconfig"
osource "C:/Nordic/NCS/v3.4.0/zephyr/soc/nuvoton/npcm/Kconfig"
osource "C:/Nordic/NCS/v3.4.0/zephyr/soc/nordic/Kconfig"
osource "C:/Nordic/NCS/v3.4.0/zephyr/soc/neorv32/Kconfig"
osource "C:/Nordic/NCS/v3.4.0/zephyr/soc/native/inf_clock/Kconfig"
osource "C:/Nordic/NCS/v3.4.0/zephyr/soc/microchip/sam/sama7/Kconfig"
osource "C:/Nordic/NCS/v3.4.0/zephyr/soc/microchip/sam/sam_d5x_e5x/Kconfig"
osource "C:/Nordic/NCS/v3.4.0/zephyr/soc/microchip/pic64/Kconfig"
osource "C:/Nordic/NCS/v3.4.0/zephyr/soc/microchip/pic32c/pic32cz_ca/Kconfig"
osource "C:/Nordic/NCS/v3.4.0/zephyr/soc/microchip/pic32c/pic32cx_sg/Kconfig"
osource "C:/Nordic/NCS/v3.4.0/zephyr/soc/microchip/pic32c/pic32cm_pl/Kconfig"
osource "C:/Nordic/NCS/v3.4.0/zephyr/soc/microchip/pic32c/pic32cm_jh/Kconfig"
osource "C:/Nordic/NCS/v3.4.0/zephyr/soc/microchip/miv/Kconfig"
osource "C:/Nordic/NCS/v3.4.0/zephyr/soc/microchip/mec/Kconfig"
osource "C:/Nordic/NCS/v3.4.0/zephyr/soc/mediatek/mt8xxx/Kconfig"
osource "C:/Nordic/NCS/v3.4.0/zephyr/soc/lowrisc/opentitan/Kconfig"
osource "C:/Nordic/NCS/v3.4.0/zephyr/soc/litex/litex_vexriscv/Kconfig"
osource "C:/Nordic/NCS/v3.4.0/zephyr/soc/ite/ec/Kconfig"
osource "C:/Nordic/NCS/v3.4.0/zephyr/soc/intel/wildcat_lake/Kconfig"
osource "C:/Nordic/NCS/v3.4.0/zephyr/soc/intel/raptor_lake/Kconfig"
osource "C:/Nordic/NCS/v3.4.0/zephyr/soc/intel/panther_lake/Kconfig"
osource "C:/Nordic/NCS/v3.4.0/zephyr/soc/intel/lakemont/Kconfig"
osource "C:/Nordic/NCS/v3.4.0/zephyr/soc/intel/intel_socfpga_std/Kconfig"
osource "C:/Nordic/NCS/v3.4.0/zephyr/soc/intel/intel_socfpga/Kconfig"
osource "C:/Nordic/NCS/v3.4.0/zephyr/soc/intel/intel_niosv/Kconfig"
osource "C:/Nordic/NCS/v3.4.0/zephyr/soc/intel/intel_ish/Kconfig"
osource "C:/Nordic/NCS/v3.4.0/zephyr/soc/intel/intel_adsp/Kconfig"
osource "C:/Nordic/NCS/v3.4.0/zephyr/soc/intel/elkhart_lake/Kconfig"
osource "C:/Nordic/NCS/v3.4.0/zephyr/soc/intel/atom/Kconfig"
osource "C:/Nordic/NCS/v3.4.0/zephyr/soc/intel/apollo_lake/Kconfig"
osource "C:/Nordic/NCS/v3.4.0/zephyr/soc/intel/alder_lake/Kconfig"
osource "C:/Nordic/NCS/v3.4.0/zephyr/soc/infineon/psoc4/Kconfig"
osource "C:/Nordic/NCS/v3.4.0/zephyr/soc/infineon/edge/Kconfig"
osource "C:/Nordic/NCS/v3.4.0/zephyr/soc/infineon/cat3/Kconfig"
osource "C:/Nordic/NCS/v3.4.0/zephyr/soc/infineon/cat1c/Kconfig"
osource "C:/Nordic/NCS/v3.4.0/zephyr/soc/infineon/cat1b/Kconfig"
osource "C:/Nordic/NCS/v3.4.0/zephyr/soc/infineon/cat1a/Kconfig"
osource "C:/Nordic/NCS/v3.4.0/zephyr/soc/gd/gd32/Kconfig"
osource "C:/Nordic/NCS/v3.4.0/zephyr/soc/gaisler/leon3/Kconfig"
osource "C:/Nordic/NCS/v3.4.0/zephyr/soc/gaisler/gr716a/Kconfig"
osource "C:/Nordic/NCS/v3.4.0/zephyr/soc/focaltech/Kconfig"
osource "C:/Nordic/NCS/v3.4.0/zephyr/soc/espressif/Kconfig"
osource "C:/Nordic/NCS/v3.4.0/zephyr/soc/ene/kb1200/Kconfig"
osource "C:/Nordic/NCS/v3.4.0/zephyr/soc/ene/kb106x/Kconfig"
osource "C:/Nordic/NCS/v3.4.0/zephyr/soc/elan/em32f967/Kconfig"
osource "C:/Nordic/NCS/v3.4.0/zephyr/soc/egis/Kconfig"
osource "C:/Nordic/NCS/v3.4.0/zephyr/soc/efinix/sapphire/Kconfig"
osource "C:/Nordic/NCS/v3.4.0/zephyr/soc/cdns/xtensa_sample_controller/Kconfig"
osource "C:/Nordic/NCS/v3.4.0/zephyr/soc/cdns/swerv/Kconfig"
osource "C:/Nordic/NCS/v3.4.0/zephyr/soc/cdns/sample_controller32/Kconfig"
osource "C:/Nordic/NCS/v3.4.0/zephyr/soc/cdns/dc233c/Kconfig"
osource "C:/Nordic/NCS/v3.4.0/zephyr/soc/brcm/bcmvk/Kconfig"
osource "C:/Nordic/NCS/v3.4.0/zephyr/soc/brcm/bcm2712/Kconfig"
osource "C:/Nordic/NCS/v3.4.0/zephyr/soc/brcm/bcm2711/Kconfig"
osource "C:/Nordic/NCS/v3.4.0/zephyr/soc/blackberry/qnxhv_vm/Kconfig"
osource "C:/Nordic/NCS/v3.4.0/zephyr/soc/bflb/Kconfig"
osource "C:/Nordic/NCS/v3.4.0/zephyr/soc/atmel/sam0/Kconfig"
osource "C:/Nordic/NCS/v3.4.0/zephyr/soc/atmel/sam/Kconfig"
osource "C:/Nordic/NCS/v3.4.0/zephyr/soc/aspeed/Kconfig"
osource "C:/Nordic/NCS/v3.4.0/zephyr/soc/arm/Kconfig"
osource "C:/Nordic/NCS/v3.4.0/zephyr/soc/arm/beetle/Kconfig"
osource "C:/Nordic/NCS/v3.4.0/zephyr/soc/antmicro/myra/Kconfig"
osource "C:/Nordic/NCS/v3.4.0/zephyr/soc/andestech/Kconfig"
osource "C:/Nordic/NCS/v3.4.0/zephyr/soc/amd/acp_6_0/Kconfig"
osource "C:/Nordic/NCS/v3.4.0/zephyr/soc/ambiq/Kconfig"
osource "C:/Nordic/NCS/v3.4.0/zephyr/soc/allwinner/sun8i_h3/Kconfig"
osource "C:/Nordic/NCS/v3.4.0/zephyr/soc/alif/ensemble/Kconfig"
osource "C:/Nordic/NCS/v3.4.0/zephyr/soc/aesc/Kconfig"
osource "C:/Nordic/NCS/v3.4.0/zephyr/soc/adi/max32/Kconfig"
osource "C:/Nordic/NCS/v3.4.0/nrf/soc/sercomm/nrf91/Kconfig"
osource "C:/Nordic/NCS/v3.4.0/nrf/soc/nordic/Kconfig"
```

## Lab_Files/Lab8_PowerManagement/2_device_pm/build/lab3_device_pm/Kconfig/arch/Kconfig
```kconfig
# Load Zephyr Arch Kconfig descriptions.
osource "C:/Nordic/NCS/v3.4.0/zephyr/arch/rx/Kconfig"
osource "C:/Nordic/NCS/v3.4.0/zephyr/arch/x86/Kconfig"
osource "C:/Nordic/NCS/v3.4.0/zephyr/arch/xtensa/Kconfig"
osource "C:/Nordic/NCS/v3.4.0/zephyr/arch/sparc/Kconfig"
osource "C:/Nordic/NCS/v3.4.0/zephyr/arch/riscv/Kconfig"
osource "C:/Nordic/NCS/v3.4.0/zephyr/arch/posix/Kconfig"
osource "C:/Nordic/NCS/v3.4.0/zephyr/arch/openrisc/Kconfig"
osource "C:/Nordic/NCS/v3.4.0/zephyr/arch/mips/Kconfig"
osource "C:/Nordic/NCS/v3.4.0/zephyr/arch/arm64/Kconfig"
osource "C:/Nordic/NCS/v3.4.0/zephyr/arch/arm/Kconfig"
osource "C:/Nordic/NCS/v3.4.0/zephyr/arch/arc/Kconfig"
```

## Lab_Files/Lab8_PowerManagement/2_device_pm/build/lab3_device_pm/Kconfig/boards/Kconfig.defconfig
```kconfig
# Load Zephyr board defconfig descriptions.
osource "C:/Nordic/NCS/v3.4.0/zephyr/boards/nordic/nrf54l15dk/Kconfig.defconfig"
```
