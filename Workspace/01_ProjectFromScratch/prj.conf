## CMakeLists.txt
```
# SPDX-License-Identifier: Apache-2.0

cmake_minimum_required(VERSION 3.20.0)

# Find external Zephyr project, and load its settings:
find_package(Zephyr REQUIRED HINTS $ENV{ZEPHYR_BASE})

# Set project name:
project (MyApp)

# add sources
target_sources(app PRIVATE src/main.c)             
```

## prj.conf
```kconfig
# This line is just a comment. In this simple project we can use the default configuration. 
```

## src/main.c
```c
#include <zephyr/kernel.h>

void main(void)
{
     printk("Hello World!\n");
}
```
